## platform/esp/resources/sdkconfig.defaults
```kconfig
CONFIG_BOOTLOADER_LOG_LEVEL_NONE=y
CONFIG_BOOTLOADER_COMPILER_OPTIMIZATION_PERF=y
CONFIG_ESP_INT_WDT=y
CONFIG_ESP_INT_WDT_TIMEOUT_MS=2000
CONFIG_LOG_COLORS=n
CONFIG_LOG_DEFAULT_LEVEL_NONE=y
CONFIG_LOG_MAXIMUM_EQUALS_DEFAULT=y
CONFIG_PARTITION_TABLE_CUSTOM=y
CONFIG_PARTITION_TABLE_CUSTOM_FILENAME="platform/esp/resources/partitions.csv"
```

## platform/esp/resources/sdkconfig.defaults.debug
```kconfig
CONFIG_ESP_INT_WDT=y
CONFIG_ESP_INT_WDT_TIMEOUT_MS=2000
CONFIG_HTTPD_MAX_REQ_HDR_LEN=1024
CONFIG_LWIP_MAX_SOCKETS=16
CONFIG_PARTITION_TABLE_CUSTOM=y
CONFIG_PARTITION_TABLE_CUSTOM_FILENAME="platform/esp/resources/partitions.csv"
```

## platform/esp/resources/sdkconfig.defaults.debug.in
```kconfig
CONFIG_COMPILER_OPTIMIZATION_SIZE=y
CONFIG_ESP_INT_WDT=y
CONFIG_ESP_INT_WDT_TIMEOUT_MS=2000
CONFIG_ESPTOOLPY_FLASHSIZE_2MB=@ESP_FLASH_SIZE_2MB@
CONFIG_ESPTOOLPY_FLASHSIZE_4MB=@ESP_FLASH_SIZE_4MB@
CONFIG_ESPTOOLPY_FLASHSIZE_8MB=@ESP_FLASH_SIZE_8MB@
CONFIG_ESPTOOLPY_FLASHSIZE_16MB=@ESP_FLASH_SIZE_16MB@
CONFIG_HTTPD_MAX_REQ_HDR_LEN=1024
CONFIG_LWIP_LOCAL_HOSTNAME="pico-fbw"
CONFIG_LWIP_MAX_SOCKETS=16
CONFIG_NEWLIB_NANO_FORMAT=y
CONFIG_PARTITION_TABLE_CUSTOM=y
CONFIG_PARTITION_TABLE_CUSTOM_FILENAME="@ESP_PARTTABLE_PATH@"
```
