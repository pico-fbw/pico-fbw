## platform/esp/resources/sdkconfig.defaults.in
```kconfig
CONFIG_APP_BUILD_GENERATE_BINARIES=y
CONFIG_BOOTLOADER_APP_ROLLBACK_ENABLE=y
CONFIG_BOOTLOADER_LOG_LEVEL_NONE=y
CONFIG_COMPILER_OPTIMIZATION_PERF=y
CONFIG_ESP_CONSOLE_USB_SERIAL_JTAG=@USE_USB_STDIO@
CONFIG_ESP_INT_WDT=y
CONFIG_ESP_INT_WDT_TIMEOUT_MS=2000
CONFIG_ESPTOOLPY_FLASHSIZE_2MB=@ESP_FLASH_SIZE_2MB@
CONFIG_ESPTOOLPY_FLASHSIZE_4MB=@ESP_FLASH_SIZE_4MB@
CONFIG_ESPTOOLPY_FLASHSIZE_8MB=@ESP_FLASH_SIZE_8MB@
CONFIG_ESPTOOLPY_FLASHSIZE_16MB=@ESP_FLASH_SIZE_16MB@
CONFIG_FREERTOS_HZ=1000
CONFIG_HTTPD_MAX_REQ_HDR_LEN=1024
CONFIG_LOG_COLORS=n
CONFIG_LOG_DEFAULT_LEVEL_NONE=y
CONFIG_LOG_MAXIMUM_EQUALS_DEFAULT=y
CONFIG_LWIP_LOCAL_HOSTNAME="@PROJECT_NAME@"
CONFIG_LWIP_MAX_SOCKETS=16
CONFIG_PARTITION_TABLE_CUSTOM=y
CONFIG_PARTITION_TABLE_CUSTOM_FILENAME="@ESP_PARTTABLE_PATH@"
```
